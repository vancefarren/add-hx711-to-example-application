## drivers/sensor/hx711/Kconfig
```kconfig
# Copyright (c) 2021 Nordic Semiconductor ASA
# SPDX-License-Identifier: Apache-2.0

config HX711
	bool "HX711 sensor"
	depends on GPIO
	help
	  Enable hx711 sensor
```

## dts/bindings/sensor/avia,hx711.yaml
```yaml
# Copyright (c) 2020 George Gkinis
# Copyright (c) 2021 Jan Gnip
# SPDX-License-Identifier: Apache-2.0

description: |
  Avia HX711 sensor

compatible: "avia,hx711"

include: base.yaml

properties:
  offset:
    type: int
    required: false
    default: 0
    description: |
      Initial offset for the driver.

  slope:
    type: array
    required: false
    default: [0 0]
    description: |
      Initial slope for the driver.

  calibration-weight:
    type: array
    required: false
    default: [0 0]
    description: |
      Default calibration weight.

  sample-fetch-timeout-ms:
    type: int
    required: false
    default: 700
    description: |
      Time until sample-fetch will wait before returning an error.

  gain:
    type: int
    required: false
    default: 1
    description: |
      Gain of the sensor. 1 = 128x, 2 = 32x, 3 = 64x
    enum:
      - 1
      - 2
      - 3

  rate-hz:
    type: int
    required: false
    default: 0
    description: |
      Sensor sample rate. 0 = 10Hz, 1 = 80Hz
      If CONFIG_PM_DEVICE_RUNTIME = y rate will not be higher
      than 2~3Hz due to the long wake-up time needed for HX711.
    enum:
      - 0
      - 1

  disable-interrupts-while-polling:
    type: boolean
    required: false
    description: |
      Disable interrupts while polling the sensor.
      Turn on if hx711 sensor reading has highest priority.

  dout-gpios:
    type: phandle-array
    required: true
    description: |
      Pin on which sensor data will be read from.

  sck-gpios:
    type: phandle-array
    required: true
    description: |
      Pin on which data fetch triggering occurs.

  rate-gpios:
    type: phandle-array
    required: false
    description: |
      Pin on which sampling rate is chosen.

  label:
    required: true
```
